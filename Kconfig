## Kconfig
```kconfig
source "drivers/media/css2600/drivers/media/pci/css2600/Kconfig"

config CSS2600_STUB
	tristate "Intel Atom ISP stubs"
	---help---
	Why not? :-)
```

## drivers/media/pci/atomisp/Kconfig
```kconfig
config VIDEO_ATOMISP_NG
	tristate "Intel Atom ISP driver prototype"
	depends on VIDEO_V4L2
	select IOMMU_API
	select IOMMU_IOVA
	select X86_DEV_DMA_OPS if X86
	select VIDEOBUF2_DMA_CONTIG
	select PHYS_ADDR_T_64BIT
	---help---
	Say Y here!
```

## drivers/media/pci/css2600/Kconfig
```kconfig
config VIDEO_CSS2600
	tristate "Intel Atom ISP driver prototype"
	depends on VIDEO_V4L2
	select IOMMU_API
	select IOMMU_IOVA
	select X86_DEV_DMA_OPS if X86
	select VIDEOBUF2_DMA_CONTIG
	select PHYS_ADDR_T_64BIT
	---help---
	Say Y here!

config VIDEO_CSS2600_ISYS
	bool "Input system"
	depends on VIDEO_CSS2600
	---help---
	FPGA based input system. Select if your FPGA based environment
	contains an input system.

config VIDEO_CSS2600_PSYS
	bool "Processing system"
	depends on VIDEO_CSS2600
	---help---
	FPGA based processing system. Select if your FPGA based
	environment contains a processing system.
```
